## firmware/usb_disk/sdkconfig.defaults
```kconfig
CONFIG_IDF_TARGET="esp32s3"
CONFIG_ESPTOOLPY_FLASHSIZE_16MB=y
CONFIG_ESPTOOLPY_FLASHMODE_DIO=y
CONFIG_ESPTOOLPY_FLASHFREQ_80M=y

CONFIG_SPIRAM=y
CONFIG_SPIRAM_MODE_OCT=y
CONFIG_SPIRAM_SPEED_80M=y
CONFIG_SPIRAM_USE_MALLOC=y
CONFIG_SPIRAM_MALLOC_ALWAYSINTERNAL=16384

CONFIG_ESP_DEFAULT_CPU_FREQ_MHZ_240=y
CONFIG_ESP_CONSOLE_UART_DEFAULT=y




CONFIG_ESP_MAIN_TASK_STACK_SIZE=8192

CONFIG_PARTITION_TABLE_CUSTOM=y
CONFIG_PARTITION_TABLE_CUSTOM_FILENAME="partitions.csv"
# 原生 USB 口給 TinyUSB 用，控制台只走 UART0（CH343）
CONFIG_ESP_CONSOLE_SECONDARY_NONE=y

# ---- 網絡後端：到雲主機的往返約幾十 ms，TCP 窗口要放大，否則吞吐被窗口/RTT 卡死 ----
CONFIG_LWIP_TCP_WND_DEFAULT=65534
CONFIG_LWIP_TCP_SND_BUF_DEFAULT=65534
CONFIG_LWIP_TCP_RECVMBOX_SIZE=64
CONFIG_LWIP_TCPIP_RECVMBOX_SIZE=64
CONFIG_ESP_WIFI_STATIC_RX_BUFFER_NUM=16
CONFIG_ESP_WIFI_DYNAMIC_RX_BUFFER_NUM=64
CONFIG_ESP_WIFI_DYNAMIC_TX_BUFFER_NUM=64
CONFIG_ESP_WIFI_RX_BA_WIN=32
CONFIG_SPIRAM_TRY_ALLOCATE_WIFI_LWIP=y
# TLS 緩衝放 PSRAM，內部 RAM 留給 USB/WiFi DMA
CONFIG_MBEDTLS_EXTERNAL_MEM_ALLOC=y
```
